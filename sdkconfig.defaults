## sdkconfig.defaults
```kconfig
# Modbus configuration - Force RTU mode
CONFIG_FMB_COMM_MODE_RTU_EN=y
CONFIG_FMB_COMM_MODE_ASCII_EN=n
CONFIG_FMB_MASTER_TIMEOUT_MS_RESPOND=1000
CONFIG_FMB_MASTER_DELAY_MS_CONVERT=200
CONFIG_FMB_QUEUE_LENGTH=20
CONFIG_FMB_PORT_TASK_STACK_SIZE=4096
CONFIG_FMB_SERIAL_TASK_STACK_SIZE=4096
CONFIG_FMB_PORT_TASK_PRIO=10
CONFIG_FMB_SERIAL_TASK_PRIO=10

# Debug configuration
CONFIG_LOG_DEFAULT_LEVEL_VERBOSE=y
CONFIG_LOG_MAXIMUM_LEVEL=5

# UART configuration for ESP32-C6
CONFIG_MB_UART_PORT_NUM=1
CONFIG_MB_UART_BAUD_RATE=19200
CONFIG_MB_UART_TXD=4
CONFIG_MB_UART_RXD=5
CONFIG_MB_UART_RTS=2
CONFIG_MB_COMM_MODE_RTU=y
CONFIG_MB_SLAVE_ADDR=197

# ESP32-C6 specific
CONFIG_IDF_TARGET="esp32c6"
```
